## config/west.yml
```yaml
manifest:
  remotes:
    - name: zmkfirmware
      url-base: https://github.com/zmkfirmware
    # Vertical OLED widgets (nice_oled shield): WPM bongo cat, Luna,
    # modifier indicators, animated peripheral cat, smart battery, etc.
    - name: mctechnology17
      url-base: https://github.com/mctechnology17
  projects:
    - name: zmk
      remote: zmkfirmware
      revision: v0.3
      import: app/west.yml
    # Fetched by `west update` (locally and in GitHub Actions)
    - name: zmk-nice-oled
      remote: mctechnology17
      revision: 46f824abb2bd41f1287c5c68abd14122af6042a3
  self:
    path: config
```
